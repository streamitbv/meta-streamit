## conf/machine/streamit-mlb400.conf
```bitbake
# Copyright (C) 2015 Romain Perier
# Released under the MIT license (see COPYING.MIT for the terms)

#@TYPE: Machine
#@NAME: Streamit Digital signage player
#@DESCRIPTION: Streamits DSP
#http://www.streamit.eu/

SOC_FAMILY = "rk3288"

require conf/machine/include/tune-cortexa17.inc
require conf/machine/include/soc-family.inc

MACHINEOVERRIDES =. "mali-gpu:mali-midgard:"

PREFERRED_PROVIDER_virtual/kernel = "linux-rockchip"
PREFERRED_VERSION_linux-rockchip = "4.4%"

SERIAL_CONSOLES = "115200;ttyS2"
KERNEL_IMAGETYPE = "zImage"
KBUILD_DEFCONFIG = "rockchip_linux_defconfig"

PREFERRED_PROVIDER_virtual/bootloader ?= "u-boot-rockchip"
SPL_BINARY ?= "u-boot-spl-dtb.bin"

IMAGE_FSTYPES += "streamit-mlb-emmc-img"
IMAGE_CLASSES += "streamit-mlb-img streamit-mlb-gpt-img streamit-mlb-emmc-img streamit-mlb-sd-img"

KERNEL_DEVICETREE = "rk3288-streamit-mlb400.dtb"
UBOOT_MACHINE = "streamit-mlb400-rk3288_defconfig"
```
